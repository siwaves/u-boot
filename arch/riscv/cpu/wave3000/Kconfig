## arch/riscv/cpu/wave3000/Kconfig
```kconfig
# SPDX-License-Identifier: GPL-2.0+
#
# Copyright (C) 2023-2024 Siliconwaves, Inc
# Richard Dai <richard@siliconwaves.com>

config SILICONWAVES_WAVE3000
	bool
	select ARCH_EARLY_INIT_R
	select RAM
	select SPL_RAM if SPL
	imply CPU
	imply CPU_RISCV
	imply RISCV_TIMER if (RISCV_SMODE || SPL_RISCV_SMODE)
	imply SPL_SIFIVE_CLINT
	imply CMD_CPU
	imply SPL_CPU
	imply SPL_OPENSBI
	imply SPL_LOAD_FIT
	imply SILICONWAVES_CACHE
	imply SILICONWAVES_CCACHE
	imply SMP
	imply SPI
	imply DM_GPIO
	imply CMD_GPIO
	imply MMC
	imply MMC_SDHCI

if ENV_IS_IN_SPI_FLASH

config ENV_OFFSET
	default 0x505000

config ENV_SIZE
	default 0x20000

config ENV_SECT_SIZE
	default 0x10000

endif # ENV_IS_IN_SPI_FLASH
```

## board/siliconwaves/w3k-fpga/Kconfig
```kconfig
if TARGET_SILICONWAVES_FPGA

config SYS_BOARD
	default "w3k-fpga"

config SYS_VENDOR
	default "siliconwaves"

config SYS_CPU
	default "wave3000"

config SYS_CONFIG_NAME
	default "siliconwaves-fpga"

config TEXT_BASE
	default 0x80200000 if SPL
	default 0x80000000 if !RISCV_SMODE
	default 0x80200000 if RISCV_SMODE

config SPL_TEXT_BASE
	default 0x08000000

config SPL_OPENSBI_LOAD_ADDR
	default 0x80000000

config SYS_INIT_SP_ADDR
	default 0x80200000

config BOARD_SPECIFIC_OPTIONS # dummy
	def_bool y
	select SILICONWAVES_WAVE3000
	select SUPPORT_SPL
	select BINMAN
	imply CMD_MMC
	imply CMD_DHCP
	imply CMD_FS_GENERIC
	imply CMD_NET
	imply CMD_PING
	imply CMD_SF
	imply IP_DYN
	imply PHY_LIB
	imply PHY_MSCC
	imply SILICONWAVES_SDHCI
	
endif
```

## configs/siliconwaves_fpga_defconfig
```kconfig
CONFIG_RISCV=y
# CONFIG_SPL_USE_ARCH_MEMMOVE is not set
CONFIG_SYS_MALLOC_LEN=0x800000
CONFIG_SYS_MALLOC_F_LEN=0x3000
CONFIG_SPL_GPIO=y
CONFIG_NR_DRAM_BANKS=1
CONFIG_DEFAULT_DEVICE_TREE="siliconwaves-w3k-fpga"
CONFIG_SPL=y
CONFIG_SYS_LOAD_ADDR=0x80200000
CONFIG_SYS_INIT_SP_ADDR=0x80200000
CONFIG_SYS_PCI_64BIT=y
CONFIG_AHCI=y
CONFIG_TARGET_SILICONWAVES_FPGA=y
CONFIG_ARCH_RV64I=y
CONFIG_RISCV_SMODE=y
CONFIG_DISTRO_DEFAULTS=y
CONFIG_HAS_CUSTOM_SYS_INIT_SP_ADDR=y
CONFIG_CUSTOM_SYS_INIT_SP_ADDR=0x80200000
CONFIG_FIT=y
CONFIG_SPL_LOAD_FIT_ADDRESS=0x84000000
CONFIG_SPL_MMC=y
CONFIG_USE_PREBOOT=y
CONFIG_PREBOOT="setenv fdt_addr ${fdtcontroladdr};fdt addr ${fdtcontroladdr};"
CONFIG_DEFAULT_FDT_FILE="siliconwaves/siliconwaves-w3k-fpga.dtb"
CONFIG_DISPLAY_CPUINFO=y
CONFIG_DISPLAY_BOARDINFO=y
CONFIG_DISPLAY_BOARDINFO_LATE=y
CONFIG_SPL_MAX_SIZE=0x100000
CONFIG_SPL_BSS_START_ADDR=0x85000000
CONFIG_SPL_STACK=0x8030000
CONFIG_SPL_BSS_MAX_SIZE=0x100000
# CONFIG_SPL_SHARES_INIT_SP_ADDR is not set
CONFIG_SYS_SPL_MALLOC=y
CONFIG_SYS_CBSIZE=256
CONFIG_SYS_PBSIZE=276
CONFIG_SYS_BOOTM_LEN=0x4000000
CONFIG_CMD_MEMINFO=y
CONFIG_SYS_RELOC_GD_ENV_ADDR=y
CONFIG_SPL_CLK=y
CONFIG_E1000=y
CONFIG_SYS_NS16550=y
CONFIG_SPL_RAM_DEVICE=y
CONFIG_SPL_RAM_SUPPORT=y
CONFIG_DISPLAY_CPUINFO=y
CONFIG_DISPLAY_BOARDINFO=y
CONFIG_DISPLAY_BOARDINFO_LATE=y
CONFIG_CACHE=y
CONFIG_SIFIVE_CCACHE=y
CONFIG_EVENT_DEBUG=y
CONFIG_SYS_MMCSD_RAW_MODE_U_BOOT_USE_SECTOR=y
CONFIG_SYS_MMCSD_RAW_MODE_U_BOOT_SECTOR=0x822
```
